## Kconfig
```kconfig
menu "UART link"

    config UART_LINK_MAX_PAYLOAD
        int "Largest message payload in bytes"
        range 8 1024
        default 256
        help
            Both ends must use the same value. Every link keeps a few buffers of this size,
            and every message in the receive queue takes this much memory.

endmenu
```

## examples/sensor_stream/main/Kconfig.projbuild
```kconfig
menu "Example"

    config EXAMPLE_UART_PORT
        int "UART port"
        range 0 2
        default 1
        help
            UART0 carries the log on most boards, so the example uses UART1.

    config EXAMPLE_TX_GPIO
        int "TX GPIO"
        default 4

    config EXAMPLE_RX_GPIO
        int "RX GPIO"
        default 5

    config EXAMPLE_BAUD_RATE
        int "Baud rate"
        default 115200

endmenu
```
